## gatt_client/main/Kconfig.projbuild
```kconfig
menu "Example Configuration"

    config EXAMPLE_DUMP_ADV_DATA_AND_SCAN_RESP
        bool "Dump whole adv data and scan response data in example"
        default n
        
    config BT_ENABLED
        bool "BT ENABLED"
        default y

    config BTDM_CTRL_MODE_BLE_ONLY
        bool "BTDM_CTRL_MODE_BLE_ONLY"
        default y

    config BTDM_CTRL_MODE_BR_EDR_ONLY
        bool "BTDM_CTRL_MODE_BR_EDR_ONLY"
        default n

    config BTDM_CTRL_MODE_BTDM
        bool "BTDM_CTRL_MODE_BTDM"
        default n
        
endmenu
```
